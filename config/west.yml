## config/west.yml
```yaml
manifest:
  remotes:
    - name: zmkfirmware
      url-base: https://github.com/zmkfirmware
    - name: capmousse
      url-base: https://github.com/CapMousse
  projects:
    - name: zmk
      remote: zmkfirmware
      revision: main
      import: app/west.yml
    - name: something-cornish
      remote: capmousse
      revision: main
  self:
    path: config
```
